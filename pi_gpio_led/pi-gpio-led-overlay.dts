// SPDX-License-Identifier: GPL-2.0
/dts-v1/;
/plugin/;

/ {
	compatible = "brcm,bcm2835";

	fragment@0 {
		target = <&gpio>;
		__overlay__ {
			pi_gpio_led_pins: pi-gpio-led-pins {
				brcm,pins = <17>;     
				brcm,function = <0>;  
				brcm,pull = <1>;     
			};
		};
	};

	fragment@1 {
		target-path = "/";
		__overlay__ {
			pi_gpio_led: pi-gpio-led {
				compatible = "student,pi-gpio-led";
				pinctrl-names = "default";
				pinctrl-0 = <&pi_gpio_led_pins>;
				led-gpios = <&gpio 17 0>;
				default-mode = "on";
				blink-period-ms = <1000>;
				status = "okay";
			};
		};
	};
};
